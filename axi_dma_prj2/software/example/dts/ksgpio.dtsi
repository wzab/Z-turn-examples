
&amba_pl {
            ksgpio {
                    compatible = "wzab,ksgpio";
                    myctl-gpios = <&axi_gpio_ctl 0 0>, /* reset */
                                  <&axi_gpio_ctl 1 0>; /* start */
            };
	};
