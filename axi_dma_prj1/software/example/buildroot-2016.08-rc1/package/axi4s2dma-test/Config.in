## axi_dma_prj1/software/example/buildroot-2016.08-rc1/package/axi4s2dma-test/Config.in
```kconfig
config BR2_PACKAGE_AXI4S2DMA_TEST
	bool "axi4s2dma-test"
	depends on BR2_LINUX_KERNEL
	select BR2_PACKAGE_AXI4S2DMA_MODULE
	help
          Test application for AXI4S2DMA core.
          It is available as an example for my VEXTPROJ project

          http://github.com/wzab/vextproj

comment "axi4s2dma test application needs a Linux kernel to be built"
	depends on !BR2_LINUX_KERNEL
```

## axi_dma_prj2/software/example/buildroot-2016.08-rc1/package/axi4s2dma-module/Config.in
```kconfig
config BR2_PACKAGE_AXI4S2DMA_MODULE
	bool "axi4s2dma-module"
	depends on BR2_LINUX_KERNEL
	help
          Driver for AXI4S2DMA core.
          It is available as an example for my VEXTPROJ project

          http://github.com/wzab/vextproj

comment "axi4s2dma module needs a Linux kernel to be built"
	depends on !BR2_LINUX_KERNEL
```

## axi_dma_prj2/software/example/buildroot-2016.08-rc1/package/axi4s2dmov-test/Config.in
```kconfig
config BR2_PACKAGE_AXI4S2DMOV_TEST
	bool "axi4s2dmov-test"
	depends on BR2_LINUX_KERNEL
	select BR2_PACKAGE_AXI4S2DMOV_MODULE
	help
          Test application for AXI4S2DMOV core.
          It is available as an example for my VEXTPROJ project

          http://github.com/wzab/vextproj

comment "axi4s2dmov test application needs a Linux kernel to be built"
	depends on !BR2_LINUX_KERNEL
```

## axi_dma_prj2/software/example/buildroot-2017.11.2/configs/zynq_zturn_defconfig
```kconfig
BR2_arm=y
BR2_cortex_a9=y
BR2_ARM_ENABLE_NEON=y
BR2_SVN="svn"
BR2_TOOLCHAIN_EXTERNAL=y
BR2_TARGET_GENERIC_ROOT_PASSWD="test"
BR2_TARGET_GENERIC_GETTY_PORT="ttyPS0"
BR2_ROOTFS_OVERLAY="../overlay"
BR2_LINUX_KERNEL=y
BR2_LINUX_KERNEL_CUSTOM_GIT=y
BR2_LINUX_KERNEL_CUSTOM_REPO_URL="https://github.com/Xilinx/linux-xlnx.git"
BR2_LINUX_KERNEL_CUSTOM_REPO_VERSION="xilinx-v2017.4"
BR2_LINUX_KERNEL_USE_CUSTOM_CONFIG=y
BR2_LINUX_KERNEL_CUSTOM_CONFIG_FILE="kernel.config"
BR2_LINUX_KERNEL_UIMAGE=y
BR2_LINUX_KERNEL_UIMAGE_LOADADDR="0x8000"
BR2_LINUX_KERNEL_DTS_SUPPORT=y
BR2_LINUX_KERNEL_USE_CUSTOM_DTS=y
BR2_LINUX_KERNEL_CUSTOM_DTS_PATH="../dts/system-top.dts  ../dts/zynq-7000.dtsi  ../dts/pcw.dtsi ../dts/pl.dtsi ../dts/ksgpio.dtsi"
BR2_PACKAGE_PYTHON=y
BR2_PACKAGE_PYTHON_READLINE=y
BR2_PACKAGE_DROPBEAR=y
BR2_PACKAGE_NANO=y
BR2_PACKAGE_AXIL2IPB_MODULE=y
BR2_PACKAGE_AXI4S2DMOV_TEST=y
BR2_TARGET_ROOTFS_CPIO_GZIP=y
BR2_TARGET_ROOTFS_INITRAMFS=y
BR2_TARGET_ROOTFS_TAR_GZIP=y
BR2_TARGET_UBOOT=y
BR2_TARGET_UBOOT_BOARDNAME="zynq_zed"
BR2_TARGET_UBOOT_CUSTOM_GIT=y
BR2_TARGET_UBOOT_CUSTOM_REPO_URL="https://github.com/Xilinx/u-boot-xlnx.git"
BR2_TARGET_UBOOT_CUSTOM_REPO_VERSION="xilinx-v2017.4"
BR2_TARGET_UBOOT_NEEDS_DTC=y
BR2_TARGET_UBOOT_NEEDS_OPENSSL=y
# BR2_TARGET_UBOOT_FORMAT_BIN is not set
BR2_TARGET_UBOOT_FORMAT_ELF=y
```

## axi_irq_prj1/software/example/buildroot-2016.08-rc1/package/axi-irq1-module/Config.in
```kconfig
config BR2_PACKAGE_AXI_IRQ1_MODULE
	bool "axi-irq1-module"
	depends on BR2_LINUX_KERNEL
	help
          Driver for AXI IRQ1 core.
          It is available as an example for my VEXTPROJ project

          http://github.com/wzab/vextproj

comment "axi-irq1 module needs a Linux kernel to be built"
	depends on !BR2_LINUX_KERNEL
```

## axi_vdma_prj1/software/example/buildroot-2016.08-rc1/package/axil2ipb-module/Config.in
```kconfig
config BR2_PACKAGE_AXIL2IPB_MODULE
	bool "axil2ipb-module"
	depends on BR2_LINUX_KERNEL
	help
          Driver for AXIL2IPB bridge.
          It is available as an example for my VEXTPROJ project

          http://github.com/wzab/vextproj

comment "axil2ipb module needs a Linux kernel to be built"
	depends on !BR2_LINUX_KERNEL
```
